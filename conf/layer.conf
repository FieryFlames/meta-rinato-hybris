## conf/layer.conf
```bitbake
BBPATH .= ":${LAYERDIR}"
BBFILES += "${LAYERDIR}/recipes*/*/*.bb ${LAYERDIR}/recipes*/*/*.bbappend"
BBFILE_COLLECTIONS += "rinato-hybris-layer"
BBFILE_PATTERN_rinato-hybris-layer := "^${LAYERDIR}/"
BBFILE_PRIORITY_rinato-hybris-layer = "7"
LAYERSERIES_COMPAT_rinato-hybris-layer = "gatesgarth"
```

## conf/machine/rinato.conf
```bitbake
#@TYPE: Machine
#@NAME: Gear 2
#@DESCRIPTION: Machine configuration for the Gear 2

require conf/machine/include/tune-cortexa7.inc
require conf/machine/include/hybris-watch.inc

PREFERRED_VERSION_android = "lollipop"

PREFERRED_PROVIDER_virtual/kernel = "linux-rinato"
PREFERRED_VERSION_linux = "3.10+lollipop"

IMAGE_INSTALL += "msm-fb-refresher brcm-patchram-plus underclock asteroid-compass"
```
